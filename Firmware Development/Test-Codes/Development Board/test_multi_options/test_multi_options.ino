/**************************************************************************
  This is an example for our Monochrome OLEDs based on SSD1306 drivers

  Pick one up today in the adafruit shop!
  ------> http://www.adafruit.com/category/63_98

  This example is for a 128x64 pixel display using I2C to communicate
  3 pins are required to interface (two I2C and one reset).

  Adafruit invests time and resources providing this open
  source code, please support Adafruit and open-source
  hardware by purchasing products from Adafruit!

  Written by Limor Fried/Ladyada for Adafruit Industries,
  with contributions from the open source community.
  BSD license, check license.txt for more information
  All text above, and the splash screen below must be
  included in any redistribution.
 **************************************************************************/

#include <SPI.h>
#include <Wire.h>
#include <Adafruit_GFX.h>
#include <Adafruit_SSD1306.h>

#define DEBOUNCE 200

#define SCREEN_WIDTH 128 // OLED display width, in pixels
#define SCREEN_HEIGHT 64 // OLED display height, in pixels

#define UP 5
#define DOWN 3

#define HIGHLIGHTER_LEN 128
#define HIGHLIGHTER_HEIGHT 10

// Declaration for an SSD1306 display connected to I2C (SDA, SCL pins)
// The pins for I2C are defined by the Wire-library.
// On an arduino UNO:       A4(SDA), A5(SCL)
// On an arduino MEGA 2560: 20(SDA), 21(SCL)
// On an arduino LEONARDO:   2(SDA),  3(SCL), ...
#define OLED_RESET     4 // Reset pin # (or -1 if sharing Arduino reset pin)
#define SCREEN_ADDRESS 0x3C ///< See datasheet for Address; 0x3D for 128x64, 0x3C for 128x32
Adafruit_SSD1306 display(SCREEN_WIDTH, SCREEN_HEIGHT, &Wire, OLED_RESET);

#define NUMFLAKES     10 // Number of snowflakes in the animation example

#define LOGO_HEIGHT   65
#define LOGO_WIDTH    129

uint8_t position = 0;
char menu[][64] = {"Change Open Time", "Change Close Time", "Change Current Time", "Factory Reset",
                   "Change Status", "Device Information", "Door Sound", "Last Chance",
                   "Change Language", "Test Mode", "Reboot", "Power Off"
                  };
uint8_t menu_count = 0;

// 'Settings-01', 129x65px
const unsigned char epd_bitmap_Settings_01 [] PROGMEM = {
  0x00, 0x00, 0x00, 0x00, 0x00, 0x00, 0x00, 0x00, 0x00, 0x00, 0x00, 0x00, 0x00, 0x00, 0x00, 0x00,
  0x00, 0x00, 0x00, 0x00, 0x00, 0x00, 0x00, 0x00, 0x00, 0x00, 0x00, 0x00, 0x00, 0x00, 0x00, 0x00,
  0x00, 0x00, 0x00, 0xff, 0xff, 0x5f, 0x80, 0x00, 0x00, 0x00, 0x00, 0x00, 0x00, 0x00, 0x00, 0x0f,
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  0x00, 0x00, 0x00, 0x00, 0x00, 0x00, 0x00, 0x00, 0x00, 0x00, 0x00, 0x00, 0x00, 0x00, 0x00, 0x00,
  0x00
};





// Array of all bitmaps for convenience. (Total bytes used to store images in PROGMEM = 1136)
const int epd_bitmap_allArray_LEN = 1;
uint8_t switched = false;

void setup() {
  Serial.begin(9600);

  // SSD1306_SWITCHCAPVCC = generate display voltage from 3.3V internally
  if (!display.begin(SSD1306_SWITCHCAPVCC, SCREEN_ADDRESS)) {
    while (true)
    {
      Serial.println(F("SSD1306 allocation failed"));
    }
  }

  pinMode(UP, INPUT_PULLUP);
  pinMode(DOWN, INPUT_PULLUP);

  attachInterrupt(digitalPinToInterrupt(UP), UP_SCREEN, FALLING);
  attachInterrupt(digitalPinToInterrupt(DOWN), DOWN_SCREEN, FALLING);

  // Clear the buffer
  display.clearDisplay();
  display.display();

  drawBitmap();
  drawText();

}

void loop() {
  if (switched)
  {
    drawText();

    switched = false;
  }
}

void drawText()
{

  display.fillRect(0, 10, 128, 45, BLACK);
  display.display();

  if ((position == 0) || (position == 4) || (position == 8))
  {
    display.fillRect(6, 12, HIGHLIGHTER_LEN, HIGHLIGHTER_HEIGHT, WHITE);
    display.display();
  } else if ((position == 1) || (position == 5) || (position == 9))
  {
    display.fillRect(6, 22, HIGHLIGHTER_LEN, HIGHLIGHTER_HEIGHT, WHITE);
    display.display();
  } else if ((position == 2) || (position == 6) || (position == 10))
  {
    display.fillRect(6, 34, HIGHLIGHTER_LEN, HIGHLIGHTER_HEIGHT, WHITE);
    display.display();
  } else if ((position == 3) || (position == 7) || (position == 11))
  {
    display.fillRect(6, 46, HIGHLIGHTER_LEN, HIGHLIGHTER_HEIGHT, WHITE);
    display.display();
  }

  display.setFont(&FreeSans5pt7b);
  display.setTextColor(WHITE);

  display.setCursor(6, 18);
  display.setTextColor(position == 0 ? BLACK : position == 4 ? BLACK : position == 8 ? BLACK : WHITE);
  display.print(menu[0 + 4 * menu_count]);
  display.display();

  display.setCursor(6, 30);
  display.setTextColor(position == 1 ? BLACK : position == 5 ? BLACK : position == 9 ? BLACK : WHITE);
  display.print(menu[1 + 4 * menu_count]);
  display.display();

  display.setCursor(6, 42);
  display.setTextColor(position == 2 ? BLACK : position == 6 ? BLACK : position == 10 ? BLACK : WHITE);
  display.print(menu[2 + 4 * menu_count]);
  display.display();

  display.setCursor(6, 54);
  display.setTextColor(position == 3 ? BLACK : position == 7 ? BLACK : position == 11 ? BLACK : WHITE);
  display.print(menu[3 + 4 * menu_count]);
  display.display();
}

void UP_SCREEN()
{
  static uint32_t ticks = 0;

  if ((millis() - ticks) > DEBOUNCE)
  {
    switched = true;

    position++;

    if ((position >= 0 && position < 4))
    {
      menu_count = 0;
    } else if ((position >= 4 && position < 8))
    {
      menu_count = 1;
    } else if ((position >= 8 && position < 12))
    {
      menu_count = 2;
    }

    if (position >= 12)position = 11;

    ticks = millis();
  }
}

void DOWN_SCREEN()
{
  static uint32_t ticks = 0;

  if ((millis() - ticks) > DEBOUNCE)
  {
    switched = true;

    position--;

    if ((position >= 0 && position < 4))
    {
      menu_count = 0;
    } else if ((position >= 4 && position < 8))
    {
      menu_count = 1;
    } else if ((position >= 8 && position < 12))
    {
      menu_count = 2;
    }

    if (position >= 12)position = 0;

    ticks = millis();
  }
}

void drawBitmap(void) {
  display.clearDisplay();

  display.drawBitmap(
    (display.width()  - LOGO_WIDTH ) / 2,
    (display.height() - LOGO_HEIGHT) / 2,
    epd_bitmap_Settings_01 , LOGO_WIDTH, LOGO_HEIGHT, 1);
  display.display();
}
